## sdkconfig.defaults
```kconfig
# M5StickC-Plus BLE Mesh Node Configuration
# ===========================================
# This file contains the essential menuconfig settings for the M5Stick IMU node.
# These settings will be applied when running "idf.py build" on a clean project.

# Bluetooth Configuration
# ------------------------
CONFIG_BT_ENABLED=y
CONFIG_BT_BLUEDROID_ENABLED=y
CONFIG_BT_BLE_ENABLED=y
CONFIG_BT_GATTS_ENABLE=y
CONFIG_BT_BLE_42_FEATURES_SUPPORTED=y

# BLE Mesh Core
# -------------
CONFIG_BLE_MESH=y
CONFIG_BLE_MESH_NODE=y
CONFIG_BLE_MESH_PB_GATT=y
CONFIG_BLE_MESH_PB_ADV=y
CONFIG_BLE_MESH_PROXY=y
CONFIG_BLE_MESH_GATT_PROXY_SERVER=y

# BLE Mesh Models
# ---------------
CONFIG_BLE_MESH_GENERIC_SERVER=y
CONFIG_BLE_MESH_SENSOR_SERVER=y

# BLE Mesh Buffer Configuration
# ------------------------------
# CRITICAL: These buffer settings are tuned for high-frequency IMU streaming
# - ADV_BUF: Network buffer count (60 for handling bursts)
# - BLE_ADV_BUF: HCI buffer count (20 for stable 10Hz streaming)
CONFIG_BLE_MESH_ADV_BUF_COUNT=60
CONFIG_BLE_MESH_BLE_ADV_BUF_COUNT=20
CONFIG_BLE_MESH_SUPPORT_BLE_ADV=y

# BLE Advertising
# ---------------
CONFIG_BT_BLE_42_ADV_EN=y
CONFIG_BTDM_BLE_ADV_REPORT_FLOW_CTRL_SUPP=y
CONFIG_BTDM_BLE_ADV_REPORT_FLOW_CTRL_NUM=100
CONFIG_BTDM_BLE_ADV_REPORT_DISCARD_THRSHOLD=20

# BLE Mesh Settings
# -----------------
CONFIG_BLE_MESH_SUBNET_COUNT=1
CONFIG_BLE_MESH_APP_KEY_COUNT=1
CONFIG_BLE_MESH_MODEL_KEY_COUNT=1
CONFIG_BLE_MESH_MODEL_GROUP_COUNT=1

# BLE Mesh Network
# ----------------
CONFIG_BLE_MESH_NET_BUF_POOL_USAGE=y
CONFIG_BLE_MESH_NET_BUF_TRACE_LEVEL_WARNING=y
CONFIG_BLE_MESH_NODE_ID_TIMEOUT=60

# Increase BT ACL connections for mesh
CONFIG_BT_ACL_CONNECTIONS=4

# NVS (Non-Volatile Storage)
# ---------------------------
CONFIG_NVS_ENCRYPTION=n

# FreeRTOS Configuration
# ----------------------
# CRITICAL: Tick rate affects task scheduling precision
CONFIG_FREERTOS_HZ=1000

# ESP32 Main Task
# ---------------
CONFIG_ESP_MAIN_TASK_STACK_SIZE=4096

# Partition Table
# ---------------
CONFIG_PARTITION_TABLE_SINGLE_APP_LARGE=y

# Debug Options (disable in production)
# --------------------------------------
CONFIG_BLE_MESH_DEBUG=n
CONFIG_BLE_MESH_DEBUG_NET=n
CONFIG_BLE_MESH_DEBUG_TRANS=n
CONFIG_BLE_MESH_DEBUG_BEACON=n
CONFIG_BLE_MESH_DEBUG_PROV=n
```
